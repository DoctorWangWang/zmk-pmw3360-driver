## src/Kconfig
```kconfig
# Sensor data simulator
#
# Copyright (c) 2019 Nordic Semiconductor
#
# SPDX-License-Identifier: LicenseRef-Nordic-5-Clause
#

menuconfig PMW3360
	bool "PMW3360 mouse optical sensor"
  select SPI
	help
	  Enable PMW3360 mouse optical sensor.

if PMW3360

config PMW3360_CPI
	int "PMW3360's default CPI"
	default 1600
	range 100 12000
	help
	  Default CPI value.

config PMW3360_CPI_DIVIDOR
	int "PMW3360's default CPI dividor"
	default 4
	range 1 12
	help
	  Default CPI dividor value.

config PMW3360_ACCEL_THRESHOLD
	int "PMW3360 acceleration threshold (|delta| <= this stays 1:1)"
	default 4
	range 1 64
	help
	  Acceleration threshold. Motion deltas at or below this absolute
	  value pass through unchanged, keeping fine control precise.

config PMW3360_ACCEL_GAIN
	int "PMW3360 acceleration gain (Q4.4: 16=1x, 24=1.5x, 32=2x)"
	default 24
	range 16 64
	help
	  Acceleration gain applied to the portion of a delta above the
	  threshold, in Q4.4 fixed point. 16 = linear, 24 = 1.5x, 32 = 2x.
	  Larger values make fast flicks travel further.

config PMW3360_SNIPE_CPI
    int "PMW3360's CPI in snipe mode"
    default 200
    range 200 3200
    help
      Snipe CPI value, with 200 step

config PMW3360_SNIPE_CPI_DIVIDOR
    int "PMW3360's CPI dividor in snipe mode"
    default 1
    range 1 100
    help
      Snipe CPI dividor value.


config PMW3360_RUN_DOWNSHIFT_TIME_MS
	int "PMW3360's default RUN mode downshift time"
	default 500
	range 10 2550
	help
	  Default RUN mode downshift down time in milliseconds.
	  Time after which sensor goes from RUN to REST1 mode.

config PMW3360_REST1_DOWNSHIFT_TIME_MS
	int "PMW3360's default REST1 mode downshift time"
	default 9220
	range 320 81600
	help
	  Default REST1 mode downshift down time in milliseconds.
	  Time after which sensor goes from REST1 to REST2 mode.

config PMW3360_REST2_DOWNSHIFT_TIME_MS
	int "PMW3360's default REST2 mode downshift time"
	default 150000
	range 3200 816000
	help
	  Default REST2 mode downshift down time in milliseconds.
	  Time after which sensor goes from REST2 to REST3 mode.

config PMW3360_POLL_INTERVAL_MS
	int "Poll interval after motion interrupt (ms)"
	default 8
	range 1 100
	help
	  After a motion interrupt, keep reading the sensor at this fixed
	  interval and report each delta, instead of a single burst read.
	  A fixed cadence keeps deltas small and even, avoiding the
	  accumulate-then-jump behaviour over BLE.

config PMW3360_POLL_COUNT
	int "Number of polls after motion interrupt"
	default 40
	range 1 255
	help
	  How many times to poll before re-arming the motion interrupt.
	  POLL_INTERVAL_MS x POLL_COUNT = the polling window after each
	  motion event.

choice
	prompt "Select PMW3360 sensor orientation"
	default PMW3360_ORIENTATION_0

config PMW3360_ORIENTATION_0
	bool "PMW3360 not rotated"

config PMW3360_ORIENTATION_90
	bool "PMW3360 rotated 90 deg clockwise"

config PMW3360_ORIENTATION_180
	bool "PMW3360 rotated 180 deg clockwise"

config PMW3360_ORIENTATION_270
	bool "PMW3360 rotated 270 deg clockwise"

endchoice

config PMW3360_INVERT_X
    bool "Invert the X axis of PMW3360 sensor"

config PMW3360_INVERT_Y
    bool "Invert the Y axis of PMW3360 sensor"

module = PMW3360
module-str = PMW3360
source "${ZEPHYR_BASE}/subsys/logging/Kconfig.template.log_config"

endif #PMW3360
```
